## Config.in
```kconfig
# Add project-specific packages for Buildroot here
#
# If these are non-proprietary, please consider contributing them back to
# Nerves or Buildroot.

source "$NERVES_DEFCONFIG_DIR/package/hailort/Config.in"
source "$NERVES_DEFCONFIG_DIR/package/hailort-drivers/Config.in"
source "$NERVES_DEFCONFIG_DIR/package/hailort-firmware/Config.in"
source "$NERVES_DEFCONFIG_DIR/package/spdlog_hailort/Config.in"
```

## package/hailort-drivers/Config.in
```kconfig
config BR2_PACKAGE_HAILORT_DRIVERS
	bool "hailort-drivers"
	depends on BR2_LINUX_KERNEL
	depends on BR2_PACKAGE_HAILORT
	select BR2_PACKAGE_HAILORT_FIRMWARE
	help
	  HailoRT PCIe drivers for Hailo AI accelerators.

	  https://github.com/hailo-ai/hailort-drivers

comment "hailort-drivers needs a Linux kernel to be built"
	depends on !BR2_LINUX_KERNEL
```

## package/hailort-firmware/Config.in
```kconfig
config BR2_PACKAGE_HAILORT_FIRMWARE
	bool "hailort-firmware"
	help
	  HailoRT firmware

	  https://github.com/hailo-ai/hailort-drivers/blob/master/download_firmware.sh
```

## package/hailort/Config.in
```kconfig
config BR2_PACKAGE_HAILORT
	bool "hailort"
	depends on BR2_TOOLCHAIN_HAS_THREADS
	depends on BR2_INSTALL_LIBSTDCPP
	depends on !BR2_PACKAGE_PROTOBUF # Use Hailort-provided version
	depends on !BR2_PACKAGE_EIGEN # Use Hailort-provided version
	select BR2_PACKAGE_SPDLOG_HAILORT
	help
	  HailoRT is a runtime library for Hailo AI accelerator devices.

	  https://github.com/hailo-ai/hailort

comment "hailort needs a toolchain with thread support and C++ support"
	depends on !BR2_TOOLCHAIN_HAS_THREADS || !BR2_INSTALL_LIBSTDCPP
```

## packages/ffmpeg-rpi/Config.in
```kconfig
config BR2_PACKAGE_FFMPEG_RPI
    bool "FFmpeg (Raspberry Pi fork)"
    select BR2_PACKAGE_ZLIB
    select BR2_PACKAGE_LIBDRM
    select BR2_PACKAGE_HAS_UDEV # for libudev
    select BR2_PACKAGE_LIBV4L
```

## packages/spdlog_hailort/Config.in
```kconfig
config BR2_PACKAGE_SPDLOG_HAILORT
	bool "spdlog_hailort"
	depends on BR2_TOOLCHAIN_HAS_THREADS
	depends on BR2_INSTALL_LIBSTDCPP
	help
          Fast C++ logging library.

	  https://github.com/gabime/spdlog

comment "spdlog_hailort needs a toolchain with thread support and C++ support"
	depends on !BR2_TOOLCHAIN_HAS_THREADS || !BR2_INSTALL_LIBSTDCPP
```
